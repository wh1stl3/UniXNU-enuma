// SPDX-License-Identifier: BSD-3-Clause
/dts-v1/;
/*
 * enuma 板级设备树（官方 format 2：device:dts/enuma.dts）。
 * 共享资源由 feeds 钉的 SM8250 共享仓 dts/sm8250.dtsi 提供（include_dirs = ["soc:dts"]）。
 * 所有硬件值必须来自本机证据。
 */
/include/ "sm8250.dtsi"

/ {
	model = "Xiaomi Pad 5 Pro 5G (enuma)";
	compatible = "xiaomi,enuma", "qcom,sm8250";

	chosen {
	};

	/*
	 * DRAM：实机 RamManagerDxe 映射 0x80000000-0x280000000（8 GiB 连续 span）。
	 * ADT 生成器要求「一个启用的 memory 节点提供连续 DRAM range」（device-tree.md），
	 * 且 [payload] dram_size 须与 reg 尺寸一致（0x200000000）。
	 * 活 FDT /memory 为三段 0x80000000-0xBBB00000、0xC0000000-0x180000000、
	 * 0x180000000-0x280000000，其中 0xBBB00000-0xC0000000 为保留空洞。
	 * 注意：本节点单段 reg 0x80000000 + 0x200000000 是 8 GiB 跨度（span），
	 * 它把 0xBBB00000-0xC0000000（约 69 MiB 空洞）包含在跨度内，
	 * 因此它不是「连续可分配内存」的证明；空洞与保留区见 porting.toml memory 区。
	 */
	memory@80000000 {
		device_type = "memory";
		reg = <0x0 0x80000000 0x2 0x00000000>;
	};

	/*
	 * TODO: reserved-memory 需 enuma 实测 UEFI 内存图逐条补入；[payload.adt] owned_memory_size
	 *       只是首入口预算（R-001）。
	 * TODO: 启用 CPU（MPIDR）、UFS/PHY、显示（DPU/DSI）、触控（GENI）、SMMU 等节点。
	 */
};
